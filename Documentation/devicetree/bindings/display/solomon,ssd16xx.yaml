## Documentation/devicetree/bindings/display/solomon,ssd16xx.yaml
```yaml
# SPDX-License-Identifier: (GPL-2.0-only OR BSD-2-Clause)
%YAML 1.2
---
$id: http://devicetree.org/schemas/display/solomon,ssd16xx.yaml#
$schema: http://devicetree.org/meta-schemas/core.yaml#

title: Solomon Systech SSD16xx controller based e-paper display panels

maintainers:
  - Devarsh Thakkar <devarsht@ti.com>

description:
  The SSD16xx family includes e-paper display controllers (SSD1673,
  SSD1680, SSD1681, SSD1683, SSD1677) with integrated gate driver,
  source driver and timing controller. Different panels use these
  controllers in monochrome or 3-color (black/white/red) configurations.
  The controller uses a 4-wire SPI interface and requires GPIO pins for
  reset, busy status, and data/command control. A 3-wire mode is also
  available where the D/C bit is transmitted along the SPI data line
  before each byte.

allOf:
  - $ref: /schemas/spi/spi-peripheral-props.yaml#

properties:
  compatible:
    items:
      - enum:
          # Good Display 4.2" 400x300 monochrome e-ink panel
          - gooddisplay,gdey042t81
      - enum:
          - solomon,ssd1683
          - solomon,ssd1677

  reg:
    maxItems: 1

  spi-max-frequency:
    maximum: 20000000

  reset-gpios:
    maxItems: 1
    description:
      GPIO connected to the RSTB (reset) pin. Active low.

  busy-gpios:
    maxItems: 1
    description:
      GPIO connected to the BUSY pin. Active high when the controller
      is busy updating the display.

  dc-gpios:
    maxItems: 1
    description:
      GPIO connected to the D/C (Data/Command) pin. Low for command,
      high for data.

  rotation:
    $ref: /schemas/types.yaml#/definitions/uint32
    enum: [0, 90, 180, 270]
    description:
      Display rotation in degrees counter clockwise.

required:
  - compatible
  - reg
  - reset-gpios
  - busy-gpios

unevaluatedProperties: false

examples:
  - |
    #include <dt-bindings/gpio/gpio.h>

    spi {
        #address-cells = <1>;
        #size-cells = <0>;

        display@0 {
            compatible = "gooddisplay,gdey042t81", "solomon,ssd1683";
            reg = <0>;
            spi-max-frequency = <2000000>;
            reset-gpios = <&gpio1 17 GPIO_ACTIVE_LOW>;
            busy-gpios = <&gpio1 18 GPIO_ACTIVE_HIGH>;
            dc-gpios = <&gpio1 19 GPIO_ACTIVE_HIGH>;
        };
    };
```
